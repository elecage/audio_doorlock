## sdkconfig.defaults
```kconfig
CONFIG_IDF_TARGET="esp32c3"
CONFIG_ESPTOOLPY_FLASHSIZE_4MB=y
CONFIG_PARTITION_TABLE_CUSTOM=y
CONFIG_PARTITION_TABLE_CUSTOM_FILENAME="partitions.csv"
CONFIG_BT_ENABLED=y
CONFIG_BT_BLE_42_FEATURES_SUPPORTED=y
# CONFIG_BT_BLE_50_FEATURES_SUPPORTED is not set
CONFIG_MBEDTLS_HKDF_C=y
# CONFIG_ENABLE_ESP32_FACTORY_DATA_PROVIDER is not set
# CONFIG_ENABLE_ESP32_DEVICE_INSTANCE_INFO_PROVIDER is not set
CONFIG_CHIP_DEVICE_SOFTWARE_VERSION=1
CONFIG_CHIP_DEVICE_SOFTWARE_VERSION_STRING="1.0"
# CONFIG_SUPPORT_CLOSURE_CONTROL_CLUSTER is not set
# CONFIG_SUPPORT_CLOSURE_DIMENSION_CLUSTER is not set
```
